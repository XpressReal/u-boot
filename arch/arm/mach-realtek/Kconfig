## arch/arm/mach-realtek/Kconfig
```kconfig
if ARCH_REALTEK

config SYS_VENDOR
	default "realtek"

choice
	prompt "Realtek board select"

config TARGET_RTD1319
	bool "Realtek RTD1319 SoC"

config TARGET_RTD1619B
	bool "Realtek RTD1619B SoC"

endchoice

config SYS_SOC
	default "realtek"

config SYS_CONFIG_NAME
	string "Board configuration name"
	default "rtd1319_emmc" if TARGET_RTD1319 && RTK_MMC_DRIVER
	default "rtd1319_spi" if TARGET_RTD1319 && SPI_RTK_SFC
	default "rtd1619b_emmc" if TARGET_RTD1619B && RTK_MMC_DRIVER
	default "rtd1619b_spi" if TARGET_RTD1619B && SPI_RTK_SFC
	default ""
	help
	  This option contains information about board configuration name.
	  Based on this option include/configs/<CONFIG_SYS_CONFIG_NAME>.h header
	  will be used for board configuration.

config RTK_MMC_DRIVER
	bool "CONFIG_RTK_MMC_DRIVER"

source "board/realtek/Kconfig"

config SPL_LDSCRIPT
        default "arch/arm/mach-realtek/u-boot-spl.lds"

endif
```

## board/realtek/Kconfig
```kconfig
config BOARD_FIT_CONFIG_NAME
	string "Board configuration name"
	default ""

config NO_RELOCATION
	bool "CONFIG_NO_RELOCATION"
	default y

config HEAP_ADDR
	hex "CONFIG_HEAP_ADDR"
	default 0x07880000

config REALTEK_I2C
	bool "CONFIG_REALTEK_I2C"
	default y

config RTL8168
	bool "CONFIG_RTL8168"
	default y

config USB_BOOT_GPIO_NUM
	int "CONFIG_USB_BOOT_GPIO_NUM"
	depends on USB_STORAGE
	default 26
```

## board/realtek/rtd1619b_emmc.its
```
/dts-v1/;

/ {
    description = "U-Boot proper and firmware blobs, loaded by U-Boot SPL";
    #address-cells = <1>;

    images {
        uboot {
            description = "U-Boot (64-bit)";
            data = /incbin/("u-boot-nodtb.bin");
            type = "firmware";
            os = "u-boot";
            arch = "arm64";
            compression = "none";
            entry = <0x03F60000>;
            load = <0x03F60000>;
            hash-1 {
                algo = "sha256";
            };
        };
        fdt {
            description = "U-Boot DTB";
            data = /incbin/("dts/dt.dtb");
            type = "flat_dt";
            arch = "arm64";
            compression = "none";
            load = <0x03000000>;
            hash-1 {
                algo = "sha256";
            };
        };
        fdt_cipher {
            description = "cipher DTBO";
            data = /incbin/("arch/arm/dts/cipher.dtbo");
            type = "flat_dt";
            arch = "arm64";
            compression = "none";
            load = <0x030F0000>;
            hash-1 {
                algo = "sha256";
            };
        };
        fdt-1 {
            description = "bleedingedge-emmc DTB";
            data = /incbin/("arch/arm/dts/rtd1619b-bleedingedge-emmc.dtb");
            type = "flat_dt";
            arch = "arm64";
            compression = "none";
            load = <0x03000000>;
            hash-1 {
                algo = "sha256";
            };
        };
        fdt-2 {
            description = "backinblack DTB";
            data = /incbin/("arch/arm/dts/rtd1619b-backinblack.dtb");
            type = "flat_dt";
            arch = "arm64";
            compression = "none";
            load = <0x03000000>;
            hash-1 {
                algo = "sha256";
            };
        };
        pcpu_cert {
            description = "Certificate for PCPU FW";
            data = /incbin/("./source/fw/PCPU_Certificate_final.bin");
            type = "firmware";
            arch = "arm64";
            compression = "none";
            load = <0x01500000>;
            hash-1 {
                algo = "sha256";
            };
        };
        pcpu {
            description = "PCPU FW";
            data = /incbin/("./source/fw/PCPU_Code_Area_final.bin");
            type = "firmware";
            arch = "arm64";
            compression = "none";
            load = <0x01500400>;
            hash-1 {
                algo = "sha256";
            };
        };
        tee {
                description = "OPTEE";
                data = /incbin/("./source/fw/Secure_OS_Area_flash_layout_0.bin");
                type = "tee";
                arch = "arm64";
                compression = "none";
                os = "tee";
                load = <0x01510000>;
                entry = <0x01510000>;
                hash-1 {
                        algo = "sha256";
                };
        };
    };

    configurations {
        default = "normal";

        normal {
            description = "Boot to U-Boot proper with FWs";
            firmware = "uboot";
            fdt = "fdt", "fdt_cipher";
            loadables = "pcpu_cert", "pcpu";
            signature-1 {
                algo = "sha256,rsa2048";
                key-name-hint = "uboot";
                sign-images = "fdt", "firmware", "loadables";
            };
            signature-2 {
                algo = "sha256,rsa2048";
                key-name-hint = "dev";
                sign-images = "fdt", "firmware", "loadables";
            };
        };

        rtd1619b-bleedingedge-emmc-tee {
            description = "rtd1619b-bleedingedge-emmc-tee";
            firmware = "uboot";
            fdt = "fdt-1", "fdt_cipher";
            loadables = "pcpu_cert", "pcpu", "tee";
            signature-1 {
                algo = "sha256,rsa2048";
                key-name-hint = "uboot";
                sign-images = "fdt", "firmware", "loadables";
            };
            signature-2 {
                algo = "sha256,rsa2048";
                key-name-hint = "dev";
                sign-images = "fdt", "firmware", "loadables";
            };
        };

        rtd1619b-bleedingedge-emmc {
            description = "rtd1619b-bleedingedge-emmc";
            firmware = "uboot";
            fdt = "fdt-1", "fdt_cipher";
            loadables = "pcpu_cert", "pcpu";
            signature-1 {
                algo = "sha256,rsa2048";
                key-name-hint = "uboot";
                sign-images = "fdt", "firmware", "loadables";
            };
            signature-2 {
                algo = "sha256,rsa2048";
                key-name-hint = "dev";
                sign-images = "fdt", "firmware", "loadables";
            };
        };

        rtd1619b-backinblack-tee {
            description = "rtd1619b-backinblack-tee";
            firmware = "uboot";
            fdt = "fdt-2", "fdt_cipher";
            loadables = "pcpu_cert", "pcpu", "tee";
            signature-1 {
                algo = "sha256,rsa2048";
                key-name-hint = "uboot";
                sign-images = "fdt", "firmware", "loadables";
            };
            signature-2 {
                algo = "sha256,rsa2048";
                key-name-hint = "dev";
                sign-images = "fdt", "firmware", "loadables";
            };
        };

        rtd1619b-backinblack {
            description = "rtd1619b-backinblack";
            firmware = "uboot";
            fdt = "fdt-2", "fdt_cipher";
            loadables = "pcpu_cert", "pcpu";
            signature-1 {
                algo = "sha256,rsa2048";
                key-name-hint = "uboot";
                sign-images = "fdt", "firmware", "loadables";
            };
            signature-2 {
                algo = "sha256,rsa2048";
                key-name-hint = "dev";
                sign-images = "fdt", "firmware", "loadables";
            };
        };
    };
};
```

## board/realtek/rtd1619b_spi.its
```
/dts-v1/;

/ {
    description = "U-Boot proper and firmware blobs, loaded by U-Boot SPL";
    #address-cells = <1>;

    images {
        uboot {
            description = "U-Boot (64-bit)";
            data = /incbin/("u-boot-nodtb.bin");
            type = "firmware";
            os = "u-boot";
            arch = "arm64";
            compression = "none";
            entry = <0x03F60000>;
            load = <0x03F60000>;
            hash-1 {
                algo = "sha256";
            };
        };
        fdt {
            description = "U-Boot DTB";
            data = /incbin/("dts/dt.dtb");
            type = "flat_dt";
            arch = "arm64";
            compression = "none";
            load = <0x03000000>;
            hash-1 {
                algo = "sha256";
            };
        };
        fdt_cipher {
            description = "cipher DTBO";
            data = /incbin/("arch/arm/dts/cipher.dtbo");
            type = "flat_dt";
            arch = "arm64";
            compression = "none";
            load = <0x030F0000>;
            hash-1 {
                algo = "sha256";
            };
        };
        pcpu_cert {
            description = "Certificate for PCPU FW";
            data = /incbin/("./source/fw/PCPU_Certificate_final.bin");
            type = "firmware";
            arch = "arm64";
            compression = "none";
            load = <0x01500000>;
            hash-1 {
                algo = "sha256";
            };
        };
        pcpu {
            description = "PCPU FW";
            data = /incbin/("./source/fw/PCPU_Code_Area_final.bin");
            type = "firmware";
            arch = "arm64";
            compression = "none";
            load = <0x01500400>;
            hash-1 {
                algo = "sha256";
            };
        };
    };

    configurations {
        default = "normal";

        normal {
            description = "Boot to U-Boot proper with FWs";
            firmware = "uboot";
            fdt = "fdt", "fdt_cipher";
            loadables = "pcpu_cert", "pcpu";
        };
    };
};
```

## common/pmic/Kconfig
```kconfig
menu "Realtek PMIC command"
config CMD_RTK_PMIC
	bool "Realtek PMIC command"
	default y
	help
	  this enable realtek pmic command

config RTK_PMIC_G2227
	bool "Enable GMT G2227 support"
	depends on CMD_RTK_PMIC
	help
	  enable GMT G2227 in Realtek PMIC command

config RTK_PMIC_G2237
	bool "Enable GMT G2237 support "
	depends on CMD_RTK_PMIC
	help
	  enable GMT G2237 in Realtek PMIC command

config RTK_PMIC_SY8827E
	bool "Enable Silergy SY8827E support"
	depends on CMD_RTK_PMIC
	help
	  enable Silergy SY8827E in Realtek PMIC command

config RTK_PMIC_SY8824C
	bool "Enable Silergy SY8827C support"
	depends on CMD_RTK_PMIC
	help
	  enable Silergy SY8827C in Realtek PMIC command

config RTK_PMIC_APW8889
	bool "Enable Anpec APW8889 support"
	depends on CMD_RTK_PMIC
	help
	  enable Anpec APW8889 in Realtek PMIC command

config RTK_PMIC_APW8886
	bool "Enable Anpec APW8886 support"
	depends on CMD_RTK_PMIC
	help
	  enable Anpec APW8886 in Realtek PMIC command

config RTK_PMIC_PWM_DT
	bool "Enable PWM DCDC support"
	default y
	depends on CMD_RTK_PMIC
	depends on RTK_PWM
	help
	  enable PWM-DCDC config form kernel DT in Realtek PMIC command

endmenu
```

## common/rtk_bsv/Kconfig
```kconfig
config CMD_RTK_BSV
	bool "Realtek BSV command"
	select RTK_OPP
	help
	  this enable realtek BSV command
```

## configs/rtd1619b_backinblack_defconfig
```kconfig
CONFIG_ARM=y
CONFIG_SKIP_LOWLEVEL_INIT=y
CONFIG_ARM_SMCCC=y
CONFIG_ARCH_REALTEK=y
CONFIG_BOARD_FIT_CONFIG_NAME="rtd1619b-backinblack"
CONFIG_TEXT_BASE=0x03F60000
CONFIG_SYS_MALLOC_LEN=0xE00000
CONFIG_SYS_MALLOC_F_LEN=0xE00000
# CONFIG_SYS_MALLOC_CLEAR_ON_INIT is not set
CONFIG_LOCALVERSION="-stark"
CONFIG_SPL_GPIO=y
CONFIG_NR_DRAM_BANKS=6
# CONFIG_ENV_IS_NOWHERE is not set
CONFIG_ENV_OFFSET_REDUND=0x100000
CONFIG_ENV_IS_IN_MMC=y
CONFIG_ENV_OFFSET=0x100000
CONFIG_ENV_SIZE=0x20000
CONFIG_SYS_MMC_ENV_DEV=0
CONFIG_SYS_MMC_ENV_PART=1
CONFIG_SYS_REDUNDAND_ENVIRONMENT=y
CONFIG_USE_DEFAULT_ENV_FILE=y
CONFIG_DEFAULT_ENV_FILE="board/realtek/rtd1619b_emmc.env"
CONFIG_DEFAULT_DEVICE_TREE="rtd1619b-backinblack"
CONFIG_SYS_BOOTM_LEN=0x01E00000
CONFIG_SPL_TEXT_BASE=0x03F00000
CONFIG_SPL_MAX_FOOTPRINT=0x00060000
CONFIG_SPL_MAX_SIZE=0x257E0
CONFIG_SPL_PAD_TO=0x257E0
CONFIG_SPL_BSS_MAX_SIZE=0x4000
CONFIG_SPL_SYS_MALLOC=y
CONFIG_SPL_HAS_CUSTOM_MALLOC_START=y
CONFIG_SPL_CUSTOM_SYS_MALLOC_ADDR=0x07880000
CONFIG_SPL_SYS_MALLOC_SIZE=0xE00000
# CONFIG_SPL_SEPARATE_BSS is not set
CONFIG_TARGET_RTD1619B=y
CONFIG_RTK_MMC_DRIVER=y
CONFIG_SPL_MMC=y
CONFIG_SPL_SERIAL=y
CONFIG_SPL=y
CONFIG_SPL_FS_FAT=y
CONFIG_SPL_FS_LOAD_PAYLOAD_NAME="u-boot.bin-rtd1619b_emmc"
# CONFIG_PSCI_RESET is not set
CONFIG_BUILD_TARGET="u-boot.itb"
CONFIG_SYS_CUSTOM_LDSCRIPT=y
CONFIG_SYS_LDSCRIPT="arch/arm/mach-realtek/u-boot.lds"
CONFIG_SYS_LOAD_ADDR=0x20000000
# CONFIG_ANDROID_BOOT_IMAGE is not set
CONFIG_HAS_CUSTOM_SYS_INIT_SP_ADDR=y
CONFIG_CUSTOM_SYS_INIT_SP_ADDR=0x14000000
CONFIG_FIT_VERBOSE=y
CONFIG_FIT_CIPHER=y
CONFIG_FIT_SIGNATURE=y
CONFIG_SPL_LOAD_FIT=y
CONFIG_SPL_LOAD_FIT_APPLY_OVERLAY=y
CONFIG_SPL_FIT_CIPHER=y
CONFIG_SPL_FIT_SIGNATURE=y
CONFIG_SPL_FIT_SOURCE="board/realtek/rtd1619b_emmc.its"
# CONFIG_USE_SPL_FIT_GENERATOR is not set
# CONFIG_BOOTMETH_EXTLINUX is not set
# CONFIG_BOOTMETH_VBE is not set
CONFIG_OF_BOARD=y
CONFIG_OF_BOARD_SETUP=y
CONFIG_OF_STDOUT_VIA_ALIAS=y
# CONFIG_BOOTSTD is not set
CONFIG_BOOTDELAY=0
CONFIG_USE_BOOTCOMMAND=y
CONFIG_SYS_CONSOLE_IS_IN_ENV=y
CONFIG_MISC_INIT_R=y
CONFIG_RTK_PMIC_APW8886=y
CONFIG_CMD_RTK_BSV=y
CONFIG_SPL_BOARD_INIT=y
# CONFIG_SPL_RAW_IMAGE_SUPPORT is not set
CONFIG_SPL_SYS_MALLOC_SIMPLE=y
CONFIG_SYS_MMCSD_RAW_MODE_U_BOOT_USE_SECTOR=y
CONFIG_SYS_MMCSD_RAW_MODE_U_BOOT_SECTOR=0x280
CONFIG_SYS_MMCSD_FS_BOOT_PARTITION=1
CONFIG_SYS_USB_FAT_BOOT_PARTITION=12
CONFIG_SPL_USB_HOST=y
CONFIG_SPL_USB_STORAGE=y
CONFIG_SPL_USB_DWC3_GENERIC=y
CONFIG_HUSH_PARSER=y
CONFIG_SYS_PROMPT="Realtek> "
CONFIG_SYS_CBSIZE=640
CONFIG_SYS_PBSIZE=665
# CONFIG_CMD_CONSOLE is not set
# CONFIG_CMD_BOOTD is not set
# CONFIG_BOOTM_VXWORKS is not set
# CONFIG_CMD_IMI is not set
# CONFIG_CMD_XIMG is not set
# CONFIG_CMD_EXPORTENV is not set
# CONFIG_CMD_IMPORTENV is not set
# CONFIG_CMD_CRC32 is not set
CONFIG_CMD_GPT=y
# CONFIG_CMD_LOADS is not set
CONFIG_CMD_MBR=y
CONFIG_CMD_MMC=y
CONFIG_CMD_PART=y
CONFIG_CMD_READ=y
CONFIG_CMD_USB=y
CONFIG_CMD_USB_MASS_STORAGE=y
# CONFIG_CMD_ECHO is not set
CONFIG_CMD_TFTPPUT=y
# CONFIG_CMD_NFS is not set
CONFIG_CMD_PING=y
CONFIG_CMD_CACHE=y
CONFIG_CMD_GETTIME=y
CONFIG_CMD_EXT2=y
CONFIG_CMD_FAT=y
CONFIG_CMD_FS_GENERIC=y
CONFIG_CMD_HASH=y
CONFIG_OF_CONTROL=y
CONFIG_OF_OVERLAY_LIST="cipher tee"
CONFIG_SPL_OF_CONTROL=y
CONFIG_SPL_MULTI_DTB_FIT=y
CONFIG_OF_LIVE=y
CONFIG_ENV_OVERWRITE=y
CONFIG_TFTP_BLOCKSIZE=400
CONFIG_SUPPORT_EMMC_BOOT=y
CONFIG_DM=y
CONFIG_SPL_DM=y
CONFIG_SPL_OF_TRANSLATE=y
# CONFIG_BLK is not set
CONFIG_USB_FUNCTION_FASTBOOT=y
CONFIG_FASTBOOT_BUF_ADDR=0x20000000
CONFIG_FASTBOOT_BUF_SIZE=0x06400000
CONFIG_MISC=y
CONFIG_MMC_IO_VOLTAGE=y
CONFIG_MMC_UHS_SUPPORT=y
CONFIG_RTK_SD_DRIVER=y
CONFIG_SPL_RTK_SD_DRIVER=y
CONFIG_SPL_PHY=y
CONFIG_PHY_RTK_RTD_USB2PHY=y
CONFIG_PHY_RTK_RTD_USB3PHY=y
CONFIG_BAUDRATE=460800
CONFIG_SYS_NS16550=y
CONFIG_SYS_NS16550_SERIAL=y
CONFIG_SYS_NS16550_REG_SIZE=-4
CONFIG_USB=y
CONFIG_DM_USB_GADGET=y
CONFIG_USB_XHCI_HCD=y
CONFIG_USB_DWC3=y
CONFIG_USB_DWC3_GENERIC=y
CONFIG_USB_STORAGE=y
CONFIG_USB_GADGET=y
CONFIG_USB_GADGET_MANUFACTURER="Realtek U-Boot"
CONFIG_USB_GADGET_VENDOR_NUM=0x18d1
CONFIG_USB_GADGET_PRODUCT_NUM=0x4e40
CONFIG_USB_FUNCTION_MASS_STORAGE=y
CONFIG_USB_MAX_CONTROLLER_COUNT=4
CONFIG_FAT_WRITE=y
# CONFIG_SPL_SHA1 is not set
CONFIG_LZO=y
CONFIG_MMC_HS200_SUPPORT=y
#CONFIG_SPL_MMC_HS200_SUPPORT=y
CONFIG_OPTEE_LIB=y
# CONFIG_EFI_LOADER is not set
```
