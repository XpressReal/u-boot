## configs/rtd1619b_spi_defconfig
```kconfig
CONFIG_ARM=y
CONFIG_SKIP_LOWLEVEL_INIT=y
CONFIG_ARM_SMCCC=y
CONFIG_ARCH_REALTEK=y
CONFIG_BOARD_FIT_CONFIG_NAME="rtd1619b-bleedingedge-spi"
CONFIG_TEXT_BASE=0x03F60000
CONFIG_SYS_MALLOC_LEN=0xE00000
CONFIG_SYS_MALLOC_F_LEN=0xE00000
# CONFIG_SYS_MALLOC_CLEAR_ON_INIT is not set
CONFIG_NR_DRAM_BANKS=6
CONFIG_ENV_SIZE=0x10000
CONFIG_ENV_OFFSET=0
CONFIG_ENV_SECT_SIZE=0x1000
CONFIG_SPL_DM_SPI=y
CONFIG_USE_DEFAULT_ENV_FILE=y
CONFIG_DEFAULT_ENV_FILE="board/realtek/rtd1619b_spi.env"
CONFIG_DEFAULT_DEVICE_TREE="rtd1619b-bleedingedge-spi"
CONFIG_SYS_BOOTM_LEN=0x01E00000
CONFIG_SPL_TEXT_BASE=0x03F00000
CONFIG_SPL_MAX_FOOTPRINT=0x00060000
CONFIG_SPL_MAX_SIZE=0x257E0
CONFIG_SPL_PAD_TO=0x257E0
CONFIG_SPL_BSS_MAX_SIZE=0x4000
CONFIG_SPL_SYS_MALLOC=y
CONFIG_SPL_HAS_CUSTOM_MALLOC_START=y
CONFIG_SPL_CUSTOM_SYS_MALLOC_ADDR=0x07880000
CONFIG_SPL_SYS_MALLOC_SIZE=0xE00000
# CONFIG_SPL_SEPARATE_BSS is not set
CONFIG_TARGET_RTD1619B=y
CONFIG_SPL_MMC=y
CONFIG_SPL_SERIAL=y
CONFIG_SPL=y
CONFIG_ENV_OFFSET_REDUND=0x10000
CONFIG_SPL_FS_FAT=y
CONFIG_SPL_FS_LOAD_PAYLOAD_NAME="u-boot.bin-rtd1619b_spi"
CONFIG_SPL_SPI_FLASH_SUPPORT=y
CONFIG_SPL_SPI=y
# CONFIG_PSCI_RESET is not set
CONFIG_BUILD_TARGET="u-boot.itb"
CONFIG_SYS_CUSTOM_LDSCRIPT=y
CONFIG_SYS_LDSCRIPT="arch/arm/mach-realtek/u-boot.lds"
CONFIG_SYS_LOAD_ADDR=0x20000000
CONFIG_HAS_CUSTOM_SYS_INIT_SP_ADDR=y
CONFIG_CUSTOM_SYS_INIT_SP_ADDR=0x14000000
CONFIG_FIT_VERBOSE=y
CONFIG_FIT_CIPHER=y
CONFIG_SPL_LOAD_FIT=y
CONFIG_SPL_LOAD_FIT_APPLY_OVERLAY=y
CONFIG_SPL_FIT_CIPHER=y
CONFIG_SPL_FIT_SOURCE="board/realtek/rtd1619b_spi.its"
# CONFIG_USE_SPL_FIT_GENERATOR is not set
# CONFIG_BOOTMETH_EXTLINUX is not set
# CONFIG_BOOTMETH_VBE is not set
CONFIG_OF_BOARD=y
CONFIG_OF_BOARD_SETUP=y
CONFIG_OF_STDOUT_VIA_ALIAS=y
# CONFIG_BOOTSTD is not set
CONFIG_BOOTDELAY=0
CONFIG_USE_BOOTCOMMAND=y
CONFIG_SYS_CONSOLE_IS_IN_ENV=y
CONFIG_MISC_INIT_R=y
CONFIG_RTK_PMIC_APW8886=y
CONFIG_CMD_RTK_BSV=y
CONFIG_SPL_BOARD_INIT=y
CONFIG_SPL_DM_SPI_FLASH=y
# CONFIG_SPL_RAW_IMAGE_SUPPORT is not set
CONFIG_SPL_SYS_MALLOC_SIMPLE=y
# CONFIG_SPL_SPI_FLASH_TINY is not set
CONFIG_SPL_SPI_LOAD=y
CONFIG_SYS_SPI_U_BOOT_OFFS=0x90000
CONFIG_HUSH_PARSER=y
CONFIG_SYS_PROMPT="Realtek> "
CONFIG_SYS_CBSIZE=640
CONFIG_SYS_PBSIZE=665
# CONFIG_CMD_CONSOLE is not set
# CONFIG_CMD_BOOTD is not set
# CONFIG_BOOTM_VXWORKS is not set
# CONFIG_CMD_IMI is not set
# CONFIG_CMD_XIMG is not set
# CONFIG_CMD_EXPORTENV is not set
# CONFIG_CMD_IMPORTENV is not set
# CONFIG_CMD_CRC32 is not set
CONFIG_CMD_GPT=y
# CONFIG_CMD_LOADB is not set
# CONFIG_CMD_LOADS is not set
CONFIG_CMD_MBR=y
CONFIG_CMD_MMC=y
CONFIG_CMD_MTD=y
# CONFIG_CMD_ECHO is not set
# CONFIG_CMD_ITEST is not set
CONFIG_CMD_TFTPPUT=y
# CONFIG_CMD_NFS is not set
CONFIG_CMD_PING=y
CONFIG_CMD_CACHE=y
CONFIG_CMD_GETTIME=y
CONFIG_CMD_FAT=y
CONFIG_CMD_MTDPARTS=y
CONFIG_MTDIDS_DEFAULT="nor0=RtkSFC"
CONFIG_MTDPARTS_DEFAULT="mtdparts=RtkSFC:576k(bootcode)ro,448k@0x90000(u-boot)"
CONFIG_OF_CONTROL=y
CONFIG_OF_OVERLAY_LIST="cipher"
CONFIG_SPL_OF_CONTROL=y
CONFIG_SPL_MULTI_DTB_FIT=y
CONFIG_OF_LIVE=y
CONFIG_ENV_OVERWRITE=y
CONFIG_ENV_IS_IN_SPI_FLASH=y
CONFIG_ENV_SECT_SIZE_AUTO=y
CONFIG_SYS_REDUNDAND_ENVIRONMENT=y
CONFIG_SYS_RELOC_GD_ENV_ADDR=y
CONFIG_TFTP_BLOCKSIZE=400
CONFIG_DM=y
CONFIG_SPL_DM=y
CONFIG_REGMAP=y
CONFIG_SPL_REGMAP=y
CONFIG_SYSCON=y
CONFIG_SPL_SYSCON=y
CONFIG_SPL_OF_TRANSLATE=y
CONFIG_MMC_IO_VOLTAGE=y
CONFIG_MMC_UHS_SUPPORT=y
CONFIG_RTK_SD_DRIVER=y
CONFIG_SPL_RTK_SD_DRIVER=y
CONFIG_MTD=y
CONFIG_DM_SPI_FLASH=y
CONFIG_SPI_RTK_SFC=y
CONFIG_SPI_FLASH_MACRONIX=y
CONFIG_SPI_FLASH_MTD=y
# CONFIG_SPI_FLASH_USE_4K_SECTORS is not set
CONFIG_BAUDRATE=460800
CONFIG_SYS_NS16550=y
CONFIG_SYS_NS16550_SERIAL=y
CONFIG_SYS_NS16550_REG_SIZE=-4
CONFIG_SPI=y
CONFIG_DM_SPI=y
CONFIG_FAT_WRITE=y
CONFIG_LZO=y
# CONFIG_EFI_LOADER is not set

# Enable LOG for debug
#CONFIG_LOGLEVEL=9
#CONFIG_LOG=y
#CONFIG_LOG_MAX_LEVEL=9
CONFIG_SPL_LOG=y
CONFIG_SPL_LOG_MAX_LEVEL=9
```
