// SPDX-License-Identifier: (GPL-2.0-or-later OR BSD-2-Clause)
/*
 * Copyright (c) 2019-2020 Realtek Semiconductor Corp.
 */

/dts-v1/;

#include "rtd13xx.dtsi"

/ {
	chosen {
		stdout-path = "serial0:460800n8";
	};
};
